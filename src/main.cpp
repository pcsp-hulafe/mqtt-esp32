#include <WiFi.h>
#include <PubSubClient.h>
#include <SPI.h>
#include <Wire.h>
#include <Adafruit_GFX.h>
#include <Adafruit_SSD1306.h>
#include "credentials.h"
#include <DHT.h>
#include <DHT_U.h>
#include <ArduinoJson.h>
#include <PubSubClient.h>


// Definiciones para el sensor DHT22
#define DHTPIN 19     // Pin donde se conecta el sensor
#define DHTTYPE DHT22   // DHT 22 (AM2302)
DHT dht(DHTPIN, DHTTYPE);

// Definiciones para el botón
#define BUTTON_PIN 5  // Pin del botón
// Configuración del display OLED
#define SCREEN_WIDTH 128 // Ancho del display OLED, en píxeles
#define SCREEN_HEIGHT 64 // Altura del display OLED, en píxeles
#define OLED_RESET     -1 // Pin de reset, -1 si no está conectado
Adafruit_SSD1306 display(SCREEN_WIDTH, SCREEN_HEIGHT, &Wire, OLED_RESET);
#define SCREEN_ADDRESS 0x3C ///< See datasheet for Address; 0x3D for 128x64, 0x3C for 128x32



WiFiClient espClient;
PubSubClient client(espClient);
float globalTemperature = 0.0;
float globalHumidity = 0.0;
String globalReceivedMessage = "";


// 'lafeb', 128x64px
const unsigned char logoDeLaFe [] PROGMEM = {
	0x00, 0x00, 0x00, 0x00, 0x00, 0x00, 0x00, 0x00, 0x00, 0x00, 0x00, 0x00, 0x00, 0x00, 0x00, 0x00, 
	0x00, 0x00, 0x00, 0x00, 0x00, 0x00, 0x00, 0x00, 0x00, 0x00, 0x00, 0x00, 0x00, 0x00, 0x00, 0x00, 
	0x00, 0x00, 0x00, 0x00, 0x00, 0x00, 0x00, 0x00, 0x00, 0x00, 0x00, 0x00, 0x00, 0x00, 0x00, 0x00, 
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	0x00, 0x00, 0x00, 0x00, 0x00, 0x00, 0x00, 0x00, 0x00, 0x00, 0x00, 0x00, 0x00, 0x00, 0x00, 0x00
};

// Array of all bitmaps for convenience. (Total bytes used to store images in PROGMEM = 1040)
const int logoDeLaFeallArray_LEN = 1;
const unsigned char* logoDeLaFeallArray[1] = {
	logoDeLaFe
};




void displayWiFiConnected() {
  display.clearDisplay();
  display.setTextSize(1);
  display.setTextColor(WHITE);
  display.setCursor(0,0);
  display.println();
  display.println();
  display.println("Wifi!");
  display.print("IP: ");
  display.println(WiFi.localIP());
  display.println();
  display.println("MQTT!");
  display.print("broker: ");
  display.println(mqtt_server);
  display.display();  // Actualizar pantalla
}

void readSensorData(float &temperature, float &humidity) {
  // Lee la humedad y temperatura del sensor
  humidity = dht.readHumidity();
  temperature = dht.readTemperature();
}

void setup_wifi() {
  Serial.println("Conectando a ");
  Serial.println(ssid);
  WiFi.begin(ssid, password);

  while (WiFi.status() != WL_CONNECTED) {
    delay(500);
    Serial.print(".");
  }

  Serial.println("");
  Serial.print("Conectado a la red WiFi, dirección IP: ");
  Serial.println(WiFi.localIP());
  displayWiFiConnected();  // Mostrar detalles de conexión
}

void publishJsonMessage(PubSubClient& client, const String& topic, const String& receivedMessage, float temperature, float humidity) {
  // Crear un objeto JSON
  StaticJsonDocument<256> doc; // Ajusta el tamaño según tus necesidades

  // Añadir datos al objeto JSON
  doc["receivedMessage"] = receivedMessage;  // Mensaje recibido por MQTT
  doc["temperature"] = temperature;          // Temperatura del sensor
  doc["humidity"] = humidity;                // Humedad del sensor

  // Crear un String con el JSON
  String jsonMessage;
  serializeJson(doc, jsonMessage);

  // Publicar el mensaje JSON
  client.publish(topic.c_str(), jsonMessage.c_str());
  Serial.println("Enviando msg MQTT");
}


void callback(char* topic, byte* message, unsigned int length) {
  // muestra los mensajes
  Serial.print("Mensaje recibido en el tema: ");
  Serial.print(topic);
  Serial.print(". Mensaje: ");

  String messageTemp;
  for (int i = 0; i < length; i++) {
    messageTemp += (char)message[i];
  }

  // Leer los datos actuales del sensor
  readSensorData(globalTemperature, globalHumidity);
  Serial.println(messageTemp);
  globalReceivedMessage = messageTemp;

  // Mostrar mensaje en el display OLED
  display.clearDisplay();
  display.setTextSize(1);
  display.setTextColor(WHITE);
  display.setCursor(0,0);
  display.print("Topic: ");
  display.println(topic);
  display.println();
  display.println("  MQTT Message:");
  display.println();
  display.println(messageTemp);

// Muestra la temperatura y la humedad
  display.print("Temp: ");
  display.print(globalTemperature);
  display.println(" C");
  
  display.print("Humidity: ");
  display.print(globalHumidity);
  display.println(" %");

  display.display();
}

void setup_mqtt() {
  client.setServer(mqtt_server, 1883);
  client.setCallback(callback);
}

void reconnect() {
  while (!client.connected()) {
    Serial.print("Intentando conexión MQTT...");
    if (client.connect("ESP32Client", mqtt_user, mqtt_password)) {
      Serial.println("conectado");
      client.subscribe("lafe/fhir2mqtt");
    } else {
      Serial.print("falló, rc=");
      Serial.print(client.state());
      Serial.println(" intentar de nuevo en 5 segundos");
      delay(5000);
    }
  }
}

void displaySensorData(float temperature, float humidity) {
  
  display.clearDisplay();
  display.drawBitmap(0, 0, logoDeLaFe, 128, 64, WHITE);
  display.setTextSize(1);
  display.setTextColor(WHITE);
  // display.setCursor(0,0);
  display.setCursor(0,35);
  display.print("Temp: ");
  display.print(temperature);
  display.println(" C");
  display.print("Humedad: ");
  display.print(humidity);
  display.println(" %");
  display.display();
}


void setup() {
  Serial.begin(115200);
  // Inicializar el display OLED
  if(!display.begin(SSD1306_SWITCHCAPVCC, SCREEN_ADDRESS)) {
    Serial.println(F("Fallo al inicializar SSD1306"));
    for(;;);
  }
  dht.begin();
  pinMode(BUTTON_PIN, INPUT_PULLUP); // Botón con resistencia de pull-up
 
  display.clearDisplay();
  // Asumiendo un logo de 128x64 píxeles, ajusta estos valores según sea necesario
  display.drawBitmap(0, 16, logoDeLaFe, 128, 64, WHITE);
  display.display();
  delay(2000); // Pausa para mostrar el logo
  display.clearDisplay();

  // Continuar con la configuración normal
  setup_wifi();
  setup_mqtt();
}

void loop() {
  if (!client.connected()) {
    reconnect();
  }
  bool buttonState = digitalRead(BUTTON_PIN); // Lee el estado del botón
  if(buttonState == LOW) { // Comprueba si el botón está presionado
    Serial.println("Pulsado el botón");
    Serial.println("Midiendo la temperatura");
    displaySensorData(globalTemperature, globalHumidity);
    Serial.println("Creando JSON");
    publishJsonMessage(client, "lafe/mqtt2fhir", globalReceivedMessage, globalTemperature, globalHumidity);

  }
  client.loop();
  // Actualizar los datos del sensor
  readSensorData(globalTemperature, globalHumidity);
}
